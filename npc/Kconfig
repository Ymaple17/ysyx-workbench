## npc/Kconfig
```kconfig
mainmenu "NPC Configuration"

choice
    prompt "Architecture Selection"
    default CHISEL

config CHISEL
    bool "Enable Chisel in-order implementation"

config BOARD_PIPELINE_CHISEL
    bool "Enable Board Pipeline Chisel implementation"

config OOOD_CHISEL
    bool "Enable OOOD Chisel (OoO 4-issue) implementation"

config OOOD_CHISEL_2
    bool "Enable OOOD Chisel (OoO 2-issue) implementation"

endchoice


if CHISEL
    choice
        prompt "Chisel Run Mode"
        default CHISEL_NPC

        config CHISEL_SOC
            bool "SOC Mode"

        config CHISEL_NPC
            bool "NPC Mode"
    endchoice
endif

if BOARD_PIPELINE_CHISEL
    choice
        prompt "Board Pipeline Chisel Run Mode"
        default BOARD_PIPELINE_CHISEL_NPC

        config BOARD_PIPELINE_CHISEL_SOC
            bool "SOC Mode"

        config BOARD_PIPELINE_CHISEL_NPC
            bool "NPC Mode"
    endchoice
endif

if OOOD_CHISEL
    choice
        prompt "OOOD Chisel Run Mode"
        default OOOD_CHISEL_NPC

        config OOOD_CHISEL_SOC
            bool "SOC Mode"

        config OOOD_CHISEL_NPC
            bool "NPC Mode"
    endchoice
endif

if OOOD_CHISEL_2
    choice
        prompt "OOOD Chisel 2-issue Run Mode"
        default OOOD_CHISEL_2_NPC

        config OOOD_CHISEL_2_SOC
            bool "SOC Mode"

        config OOOD_CHISEL_2_NPC
            bool "NPC Mode"
    endchoice
endif


config BATCH_MODE
    bool "Enable Batch Execution (Disable Stepping)"
    default n

config DIFFTEST
    bool "Enable difftest"
    default n

config WAVEFORM
    bool "Enable waveform recording"
    default n

config NVBOARD
    bool "Enable NVBoard"
    default n

config ITRACE
    bool "Enable instruction tracing"
    default n
    help
      Enable real-time tracing of executed instructions.

config TRACE_DIFF
    bool "Enable Trace Diff"
    default n
    help
      Enable trace difference comparison for debugging.




config AXI_MONITOR
    bool "Enable AXI protocol monitor"
    default n
    help
      Enable real-time AXI protocol monitoring and stall detection.
      Reports protocol violations with module and signal names.

config MTRACE
    bool "Enable memory tracing"
    default n

# 设备支持配置
config DEVICE
    tristate "Enable device support"
    default y
    
```

## npc/configs/board_pipeline_npc_defconfig
```kconfig
CONFIG_BOARD_PIPELINE_CHISEL=y
CONFIG_BOARD_PIPELINE_CHISEL_NPC=y
CONFIG_BATCH_MODE=y
CONFIG_DIFFTEST=y
# CONFIG_DEVICE is not set
```

## npc/configs/board_pipeline_soc_defconfig
```kconfig
CONFIG_BOARD_PIPELINE_CHISEL=y
CONFIG_BOARD_PIPELINE_CHISEL_SOC=y
CONFIG_BATCH_MODE=y
# CONFIG_DEVICE is not set
```
